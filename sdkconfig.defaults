## sdkconfig.defaults
```kconfig
CONFIG_ESP_HTTPS_SERVER_ENABLE=y
CONFIG_HTTPD_WS_SUPPORT=y

# Flash size configuration
CONFIG_ESPTOOLPY_FLASHSIZE_4MB=y
CONFIG_ESPTOOLPY_FLASHSIZE="4MB"

# Custom OTA partition table
CONFIG_PARTITION_TABLE_CUSTOM=y
CONFIG_PARTITION_TABLE_CUSTOM_FILENAME="partitions_ota.csv"
CONFIG_PARTITION_TABLE_FILENAME="partitions_ota.csv"

# Enable app rollback
CONFIG_BOOTLOADER_APP_ROLLBACK_ENABLE=y

# WiFi Configuration
CONFIG_MCP_WIFI_SSID="YOUR_WIFI_SSID"
CONFIG_MCP_WIFI_PASSWORD="YOUR_WIFI_PASSWORD"

# WiFi Buffer Optimization - saves ~55KB heap
CONFIG_ESP_WIFI_DYNAMIC_RX_BUFFER_NUM=16
CONFIG_ESP_WIFI_DYNAMIC_TX_BUFFER_NUM=16
CONFIG_ESP_WIFI_STATIC_RX_BUFFER_NUM=6
CONFIG_ESP_WIFI_MGMT_SBUF_NUM=16
CONFIG_ESP_WIFI_RX_MGMT_BUF_NUM_DEF=3
CONFIG_ESP_WIFI_TX_BA_WIN=3
CONFIG_ESP_WIFI_RX_BA_WIN=3

# Task Stack Optimization - saves ~2.5KB heap
CONFIG_ESP_MAIN_TASK_STACK_SIZE=3072
CONFIG_ESP_TIMER_TASK_STACK_SIZE=3072
CONFIG_LWIP_TCPIP_TASK_STACK_SIZE=2560
CONFIG_FREERTOS_TIMER_TASK_STACK_DEPTH=1536
CONFIG_FREERTOS_IDLE_TASK_STACKSIZE=1024

# MCP Server Configuration
CONFIG_BLINK_GPIO=2
CONFIG_MCP_MAX_MESSAGE_SIZE=4096
CONFIG_MCP_MAX_TOOL_RESULT_SIZE=2048

# Logging and OTA Configuration
CONFIG_MCP_LOG_BUFFER_SIZE=4096
CONFIG_MCP_OTA_URL="http://YOUR_HOST:8080/wss_server.bin"

# SPIFFS Configuration
CONFIG_SPIFFS_MAX_PARTITIONS=1
```
